## boards/shields/Kconfig.defconfig
```kconfig
if SHIELD_COWBOARD_LEFT

config ZMK_KEYBOARD_NAME
    default "Cowboard Left"

endif
```

## boards/shields/cowboard_left/Kconfig.defconfig
```kconfig
if SHIELD_LCOWBOARD

config ZMK_KEYBOARD_NAME
    default "Cowboard Left"

endif
```
